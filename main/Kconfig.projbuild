## main/Kconfig.projbuild
```kconfig
menu "Wifi Configuration"

    config ESP_WIFI_SSID
        string "WiFi SSID"
        default "myssid"
        help
            SSID (network name) for the example to connect to.

    config ESP_WIFI_PASSWORD
        string "WiFi Password"
        default "mypassword"
        help
            WiFi password (WPA or WPA2) for the example to use.

    config ESP_MAXIMUM_RETRY
        int "Maximum retry"
        default 5
        help
            Set the Maximum retry to avoid station reconnecting to the AP unlimited when the AP is really inexistent.
endmenu

menu "MQTT Configuration"

    config ESP_MQTT_HOST_URI
        string "MQTT host URI"
        default "mqtt://id:pass@192.168.0.2"
        help
            MQTT broker's URI which this client to connect.

    config ESP_MQTT_TOPIC
        string "MQTT topic to use"
        default "home/cam0"
        help
            MQTT topic to use.
endmenu

menu "Camera configuration"
      
config OV2640_SUPPORT
	bool "OV2640 Support"
	default y
	help
		Enable this option if you want to use the OV2640.
		Disable this option to save memory.

config OV7725_SUPPORT
	bool "OV7725 Support"
	default n
	help
		Enable this option if you want to use the OV7725.
		Disable this option to save memory.
	
config OV3660_SUPPORT
    bool "OV3660 Support"
    default n
    help
        Enable this option if you want to use the OV3360.
        Disable this option to save memory.
    
config OV5640_SUPPORT
    bool "OV5640 Support"
    default n
    help
        Enable this option if you want to use the OV5640.
        Disable this option to save memory.
    
config SCCB_HARDWARE_I2C
    bool "Use hardware I2C for SCCB"
    default y
    help
        Enable this option if you want to use hardware I2C to control the camera.
        Disable this option to use software I2C.
    
choice SCCB_HARDWARE_I2C_PORT
    bool "I2C peripheral to use for SCCB"
    depends on SCCB_HARDWARE_I2C
    default SCCB_HARDWARE_I2C_PORT1

    config SCCB_HARDWARE_I2C_PORT0
        bool "I2C0"
    config SCCB_HARDWARE_I2C_PORT1
        bool "I2C1"

endchoice

choice CAMERA_TASK_PINNED_TO_CORE
    bool "Camera task pinned to core"
    default CAMERA_CORE0
    help
        Pin the camera handle task to a certain core(0/1). It can also be done automatically choosing NO_AFFINITY.

    config CAMERA_CORE0
        bool "CORE0"
    config CAMERA_CORE1
        bool "CORE1"
    config CAMERA_NO_AFFINITY
        bool "NO_AFFINITY"

endchoice
    
endmenu
```
